## drivers/eva8m/Kconfig
```kconfig
# Copyright (c) 2024 Kees Bakker, SODAQ
#
# This file is subject to the terms and conditions of the GNU Lesser
# General Public License v2.1. See the file LICENSE in the top level
# directory for more details.
#

config MODULE_EVA8M
    bool "EVA 8M GNSS module"
    depends on HAS_PERIPH_I2C
    depends on TEST_KCONFIG
    select MODULE_PERIPH_I2C

config HAVE_EVA8M
    bool
    help
        Indicates that a u-blox EVA 8M GNSS module is present.
```

## drivers/ublox_g350/Kconfig
```kconfig
# Copyright (c) 2022 IJzerbout IT
#
# This file is subject to the terms and conditions of the GNU Lesser
# General Public License v2.1. See the file LICENSE in the top level
# directory for more details.

config MODULE_UBLOX_G350
    bool "ublox_g350"
    depends on TEST_KCONFIG
    depends on HAS_PERIPH_RTC
    depends on HAS_PERIPH_TIMER
    depends on HAS_PERIPH_UART
    select MODULE_PERIPH_RTC
    select MODULE_PERIPH_TIMER
    select MODULE_PERIPH_UART
    select MODULE_AT
    select MODULE_ZTIMER_MSEC
```
